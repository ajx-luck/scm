/**********************************************************

**********************************************************/

#include <sc.h>



void DelayXms(unsigned char x);


/***********************************************************
函数名称：DelayXms
函数功能：毫秒级非精准延时
入口参数：x - 延时时间
出口参数：
备    注：
***********************************************************/
void DelayXms(unsigned char x)
{
	unsigned char i,j;
	for(i=x;i>0;i--)
		for(j=153;j>0;j--);
}

/***********************************************************
main主函数
***********************************************************/

void Init_System();
void Sleep_Mode();

void main()
{
	Init_System();
	while(1)
	{
		RB6=1;
		DelayXms(100);
		RB6 = 0;
		DelayXms(100);
		RB6=1;
		DelayXms(100);
		
		Sleep_Mode();
	}
}


/***********************************************
函数名称：Sleep_Mode
函数功能：进入休眠模式
入口参数：无
出口参数：无
备注：
************************************************/
void Sleep_Mode()
{
	INTCON = 0;		
	
	OPTION_REG = 0;

	TRISA = 0B00000000; 		//关闭所有输出
	PORTA = 0B00000000;
	WPUA  = 0B00000000;
	
	TRISB = 0B00001000;	
	PORTB = 0B00000000;
	
	PORTB = 0;
	WPUB  = 0B00001000;		 //RB3 上拉
	
	ADCON0 = 0;					//关闭所有模块
	PWMCON0 = 0;
	
	EECON1 = 0;					//清此寄存器,有好处

   			
   	IOCB = 0B00001000;			//允许RB3的IO口电平变化中断
	RBIE = 1;					//允许PORTB电平变化中断
	GIE = 1;					//GIE = 0时，唤醒后执行SLEEP后程序;GIE = 1时，唤醒后跳至中断服务
	
	
	OSCCON = 0X70;				//配置振荡为16M,关闭WDT
	
	PORTB;						//读PORTB值并锁存			
	asm("clrwdt");

	asm("sleep");				//进入休眠模式
	
	asm("nop");
	Init_System();
	
}

/***********************************************
函数名称：Init_System
函数功能：系统初始化
入口参数：无
出口参数：无
备注：
************************************************/
void Init_System()
{
	asm("nop");
	asm("clrwdt");
	INTCON = 0;					//系统初始化
	OSCCON = 0X70;				//配置振荡为8M,关WDT
	OPTION_REG = 0;
	
    WPUA  = 0B00000000;			//初始化上拉
    WPUB  = 0B00001000;			
  
 
	TRISA = 0B00000000;			//初始化IO状态
	TRISB = 0B00001000;

	PORTA = 0B00000000;
	PORTB = 0B00000000;			//初始化输出

}

/***********************************************
函数名称：PB_Isr
函数功能：PB电平变化中断服务
入口参数：无
出口参数：无
备注：
************************************************/
void interrupt PB_Isr()
{
	if(RBIF)
	{
		RBIF = 0;			//清中断标志
		RB6 = ~RB6;
		PORTB;				//如不关闭PB中断，则需再读取一遍PB，否则会频繁进入中断
		//Init_System();
	}
}
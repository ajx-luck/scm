/**********************************************************

**********************************************************/

#include <sc.h>



/***********************************************************
main主函数
***********************************************************/

void Init_System();


void main()
{
	Init_System();
	LVDIE =1;  //开启LVD中断
	LVDCON = 0b00000111;  // 3V LVD 

	while(1)
	{
		asm("clrwdt");
		if(LVD_RES==0)  //VDD高于3V
		{
			RB6=1;
		}
		else
		{
			RB6=0;	
		}
	
	}
}




/***********************************************
函数名称：Init_System
函数功能：系统初始化
入口参数：无
出口参数：无
备注：
************************************************/
void Init_System()
{
	asm("nop");
	asm("clrwdt");
	INTCON = 0;					//系统初始化
	OSCCON = 0X72;				//配置振荡为8M,开 WDT
	OPTION_REG = 0;
	
    WPUA  = 0B00000000;			
    WPUB  = 0B00001000;			//初始化RB3上拉
  
 
	TRISA = 0B00000000;			//初始化IO状态
	TRISB = 0B00001000;

	PORTA = 0B00000000;
	PORTB = 0B00000000;			//初始化输出
		
	PEIE =1;
	GIE = 1;					//

}

/***********************************************
函数名称：LVD_Isr
函数功能：PB电平变化中断服务
入口参数：无
出口参数：无
备注：
************************************************/
void interrupt LVD_Isr()
{
	
	if(LVDIF==1)    //LVD 中断清中断标志
	{
		LVDIF = 0;
		RB6 = 0;	

	}

}
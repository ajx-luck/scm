/***********************************************************************
方案说明：
***********************************************************************/
/**********************************************************************/
/*修改说明*/

/**********************************************************************/
/**********************************************************************/
/**********************************************************************/
/*头文件*/
#include <cms.h>
#include "main.h"
#include "delay.h"
#include "mytype.h"
#include "WHQ_TP_ZPGS.h"
#include "CMWater.h"
#include "WHQ_Sender.h"
/**********************************************************************/
/**************************************
1、WHQ_SENDER_ENABLE定义为1时为调试模式，可观察雾化器的主要数据；
2、正常使用时请把WHQ_SENDER_ENABLE定义为0；
**************************************/
/**********************************************************************/
volatile unsigned char tcount;
volatile bit errf;
volatile bit errff;
volatile bit onoff;
volatile bit wonf;
/**********************************************************************/
/**********************************************************************/
/***********************************************************************
子函数功能：上电初始化系统寄存器
入口参数：
返回数据：
备注：
***********************************************************************/
void Init_ic (void)
{
	PORTA = 0;
	PORTB = 0;
	INTCON = 0xC0;
	PIR1 = 0;
	PIR2 = 0;
	WDTCON = 0x01;
	TRISA = 0xfe;
	TRISB = 0xff;
	OPTION_REG = 0;
	OSCCON = 0x71;
	PIE1 = 0;
	PIE2 = 0;
	IOCB = 0;
	WPUA = 0;
	WPUB = 0;
}
/***********************************************************************
函数功能：初始上电RAM赋值
入口参数：
返回数据：
备注：
***********************************************************************/
void Init_ram (void)
{
	PIE2 = 0;
	PIE1 = 0B00000010;
	PR2 = 125;				//16M下将TMR2设置为125us中断
	T2CON = 5;				//使能定时器2
	INTCON = 0XC0;			//使能中断
	onoff = 1;
}
/***********************************************************************
函数功能：系统寄存器刷新
入口参数：
返回数据：
备注：
***********************************************************************/
void Sys_set (void)
{
	asm("clrwdt");
	WDTCON = 0x01;
	TRISA = 0xfe;
	TRISB = 0x00;
	OPTION_REG = 0;
	PIE1 = 0B00000010;
	PR2 = 125;
	INTCON = 0XC0;
	if(5 != T2CON)
		T2CON = 5;
}
/***********************************************************************
函数功能：触摸检水子函数
入口参数：
返回数据：
备注：有无缺水用全局标志位wnonf确定
***********************************************************************/
void Set_CM_water(void)
{
	//uchar	etempl,etemph;
	//static	bit		readfstf = 0;
	uchar	templ;
	static	uint	wdlyc;
	static	bit		wcmtonf = 0;
	static uint sec = 0;
	static uchar SDFst;
	static uchar WatSec;
	/******************************************************************/
	if(!wcmtonf)
	{
		if(++wdlyc > 200)				//上电延时0.5S等电压稳定再去检测触摸
		{
			wdlyc = 0;
			wcmtonf = 1;
		}
	}
	else
	{
		/*if(!readfstf)
		{
			readfstf = 1;
			if((0x29 != Set_jiyi_re(Checkl_Adr)) || (0x15 != Set_jiyi_re(Checkh_Adr)))	//没有存贮则上电预写一个数据
			{
				wat_ram=100;												//此处直接赋值TKEYCON1水位初始值
				wat_base=200;												//此处直接赋值TKEYCON1水位基准值

				etempl=(uchar)wat_ram;										//取低8位
				etemph=(uchar)(wat_ram/256);								//取高8位
				Set_jiyi_wr(etemph,Wat_Adrh);
				Set_jiyi_wr(etempl,Wat_Adrl);
				
				etempl=(uchar)wat_base;										//取低8位
				etemph=(uchar)(wat_base/256);								//取高8位
				Set_jiyi_wr(etemph,Base_Adrh);
				Set_jiyi_wr(etempl,Base_Adrl);
				
				Set_jiyi_wr(0x29,Checkl_Adr);
				Set_jiyi_wr(0x15,Checkh_Adr);
			}
			return;
		}*/ //建议此功能不要用
		
		if(!SDFst)
		{
			if(++sec >= 100)
			{
				sec = 0;
				SDFst = 1;
			}
		}
		else
		{
			if(++WatSec >= 4)//4次调用一次
			{
				WatSec = 0;
			}
			else
			{
				return;
			}
		}
		
		templ = Water_test();
		if(0xff == templ)
		{
			errff = 1;					//硬件错误
		}
		else if(0 == templ)
		{
			wonf = 0;
			if(onoff)
			{
				errf = 1;				//触摸检测缺水
			}
		}
		else if(1 == templ)
		{
			wonf = 1;					//检测到有水时才开机
			onoff = 1;
			errf = 0;
		}
	}
}

/***********************************************************************
函数功能：	测试模式清EE数据
返回数据：	0：发生错误
			1：没有进入测试模式
			0xff：清EE数据OK
***********************************************************************/
void Test_mode(void)
{
	static uint	testcl,testch;
	static bit keyf;
	/******************************************************************/
	if(1)
	{
		testcl = 0;
		if(++testch >= 20)
		{
			testch = 0;
			keyf = 0;
		}
	}
	else
	{
		testch = 0;
		if(++testcl >= 800)					//2.5ms主循环则是2s
		{
			testcl = 0;
			if(!keyf)
			{
				keyf = 1;
				if(0 == Wee_cm_clr())
				{
					errff = 1;
				}
			}
		}
	}
}
/***********************************************************************
子函数功能：调用追频
入口参数：
返回数据：
备注：
***********************************************************************/
void	Pwm_Test(void)
{
	uchar	templ;
	templ = Test_Pwm();
	
	if(0x55 == templ)
		errf = 1;
	else if(0xff == templ)
		errf = 1;
}

/***********************************************************************
函数功能：工作处理
入口参数：
返回数据：
备注：
***********************************************************************/
void	Set_Work(void)
{
	if(errf)
	{
		errf = 0;
		onoff = 0;
	}
}

/***********************************************************************
函数功能：中断入口函数
***********************************************************************/
void interrupt time0(void)
{
	if(TMR2IF)
	{
		TMR2IF = 0;
		tcount ++;
		if(onoff)
		{
			Set_Pwm_Onoff(20);
		}
		else
		{
			Set_Pwm_Onoff(0);
		}
	}
	else
	{
		PIR1 = 0;
		PIR2 = 0;
	}
}

/***********************************************************************
main主函数
***********************************************************************/
void main(void)
{
	static uint sec;
	/******************************************************************/
	asm("clrwdt");
	Init_ic();
	Delay_nms(200);													//上电延时200ms	
	Init_ram();														//上电给初值
	/*
	if(0 == Wee_cm_clr())//测试模式清EE数据
	{
		errff = 1;
	}
	*/	
	while(1)
	{
		if(tcount >= 40)
		{
			tcount = 0;												//主程序循环5ms
			Sys_set();
			Set_CM_water();
			#if (WHQ_SENDER_ENABLE == 1)//调试宏定义是否为1
				WHQ_SenderLoop();//发码子程序
			#endif			
			Set_Work();
			Pwm_Test();
		}
	}
}
/**********************************************************************/




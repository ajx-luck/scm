/**********************************************************

**********************************************************/

#include <sc.h>

volatile unsigned int   result,result1,result2;
volatile unsigned char ReceBuffer;	//接收到的数据
volatile unsigned char SendBuffer;	//待发送的数据
volatile unsigned char IICReadData;

void DelayXms(unsigned char x);
void Init_System();

/***********************************************************
函数名称：DelayXms
函数功能：毫秒级非精准延时
入口参数：x - 延时时间
出口参数：
备    注：
***********************************************************/
void DelayXms(unsigned char x)
{
	unsigned char i,j;
	for(i=x;i>0;i--)
		for(j=153;j>0;j--);
}

/***********************************************************
main主函数
***********************************************************/

void main()
{
	Init_System();
	
	/**************SPICON*********************
		Bit7 SPIWCOL: 写冲突标志位  
			1= 在发送/接收数据过程中，试图对SPIBUF寄存器进行写操作。 
			0= 未发生冲突。 
		Bit6 SPIOV: 接收溢出指示位。 
			1= SPIBUF仍保持前一数据时，又收到一个新的字节。出现溢出时，SPISR中的数据会丢失。溢出只会在从动模式下发生。
				在从动模式中，即使仅发送数据，用户也必须读SPIBUF以避免溢出。
				在主控模式中，溢出位不被置1，因为每次接收或发送新数据，都要通过写SPIBUF寄存器来启动（该位必须由软件清零）。 
			0= 没有溢出。 
		Bit5 SPIEN: SPI使能位。 
			1= 使能串行端口并将SCK、SDO、SDI和SS配置为串行端口引脚。
			0= 禁止串行端口并将这些引脚配置为I/O端口引脚。 
		Bit4 SPICKP: 时钟极性选择位。 
			1= 时钟空闲状态为高电平。 
			0= 时钟空闲状态为低电平。 
		Bit3~Bit0 SPIM<3:0>: 同步串行端口模式选择位； 
			0000= SPI主控模式，时钟= FSYS/4； 
			0001= SPI主控模式，时钟= FSYS/16； 
			0010= SPI主控模式，时钟= FSYS/64； 
			0011= SPI主控模式，时钟= TMR2输出/2； 
			0100= SPI从动模式，时钟= SCK引脚，使能SS引脚控制； 
			0101= SPI从动模式，时钟= SCK引脚，禁止SS引脚控制，SS可用作I/O引脚；
	*************************************************/ 
	SPICON =   0B00100100;  // SPI  使能 从动模式
	
	/***********SPICON2********************************************
		Bit7 保留 需写0 
		Bit6 CKE: SPI时钟边沿选择位。（注：在从动模式下，CKE必须设置为0） 
			SPICKP= 0  0= 在SCK引脚的上升沿发送数据； 1= 在SCK引脚的下降沿发送数据。 
			SPICKP = 1  0 = 在SCK引脚的下降沿发送数据；  1 = 在SCK引脚的上升沿发送数据。 
		Bit5 MODE: 模式选择  
				1=3线模式 (当需要发送时，SDIO口TRIS位需清0；当需要接收时，SDIO口TRIS需置1)  
				0=4线模式 
		Bit4~Bit1 未用。 
		Bit0 SPIBF 缓冲器满状态位。  
				1= 接收完成，SPIBUF满。  0= 接收未完成，SPIBUF空
	************************************************************/
	SPICON2 =  0B00000000;  // SPI  4线  从动模式
    
	 SPIIF =0;
	 SPIIE=1;
	 PEIE =1;
	 GIE =1;  

	while(1)
	{
         DelayXms(200);

	}
}



/***********************************************
函数名称：Init_System
函数功能：系统初始化
入口参数：无
出口参数：无
备注：
************************************************/
void Init_System()
{
	asm("nop");
	asm("clrwdt");
	INTCON = 0;					//系统初始化
	OSCCON = 0X70;				//配置振荡为8M,关WDT
	OPTION_REG = 0;
	
    WPUA  = 0B00000000;			//初始化上拉
    WPUB  = 0B00001000;			
  
 
	TRISA = 0B00000000;			//初始化IO状态
	TRISB = 0B01110100;

	PORTA = 0B00000000;
	PORTB = 0B00000000;			//初始化输出

}

/***********************************************
函数名称：SPI_Isr
函数功能：SPI中断服务
入口参数：无
出口参数：无
备注：
************************************************/
void interrupt SPI_Isr()
{
	
	if(SPIIF==1)
	{
	   SPIIF = 0;
	   
	   ReceBuffer = SPIBUF;
	   SPIBUF =0xaa;	
	
	}
}
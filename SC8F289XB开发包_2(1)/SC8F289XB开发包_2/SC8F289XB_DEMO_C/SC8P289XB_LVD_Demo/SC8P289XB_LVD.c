/*-------------------------------------------
功能：LVD模块演示
版本：V1.0
日期：2021.01.04 

*本程序由 中微半导体 &应用支持部& 编写整理
*公司网址 www.mcu.com.cn

-------------------------------------------*/

#include <sc.h>

void main()
{
	asm("nop");
	asm("clrwdt");
	
	
	OSCCON = 0x72;			//内部振荡器用作系统时钟，8M，开WDT
	OPTION_REG = 0;			//预分频寄存器设置	
	TRISA = 0;
	
	/****************  LVDCON   ***************************************
		Bit7 LVD_RES: LVD输出结果 
			0= VDD>设定的LVD电压； 
			1= VDD<设定的LVD电压； 
		Bit6~Bit4 未用 
		Bit3~Bit1 LVD_SEL[2:0]: LVD电压选择 
			000= 2.2V； 
			001= 2.4V； 
			010= 2.7V； 
			011= 3.0V； 
			100= 3.3V； 
			101= 3.7V； 
			110= 4.0V； 
			111= 4.3V； 
		Bit0 LVDEN: LVD使能位 0= 禁止； 1= 使能；
	*********************************************************/ 	
	LVDCON = 0x07;			//LVD电压设定3.0V,使能LVD
							//LVD使能后需延时1ms才可以读取LVD_RES，且VDD变化后1ms，LVD_RES才有输出
	INTCON = 0xC0;			//允许所有未被屏蔽的中断、允许外设中断	
	PIE2 = 0x01;			//允许LVD中断
//---------------------------------------		

	while(1)			
	{
		asm("clrwdt");
		if (LVD_RES)		//VDD<3V,则LVD_RES=1
			RA2 = 1;
		else
			RA2 = 0;
	}
}

/***********************************************
函数名称：LVD_Isr
函数功能：LVD中断服务
入口参数：无
出口参数：无
备注：
************************************************/
void interrupt LVD_Isr()
{
	if(LVDIF)				//VDD < LVD设定电压值(3.0V)
	{
		LVDIF = 0;			//清中断标志		
	}
}